## main/Kconfig.projbuild
```kconfig
menu "FlowCount people counter"
config PC_BOARD_PINS_CONFIRMED
    bool "Board pinout verified"
    default n
    help
        Enable only after verifying camera SDA/SCL and power against
        your board schematic. Without this option the firmware will not access the camera.
config PC_CAMERA_SDA
    int "Camera SDA GPIO"
    range 0 54
    default 7
config PC_CAMERA_SCL
    int "Camera SCL GPIO"
    range 0 54
    default 8
config PC_CAMERA_RESET
    int "RESET GPIO (-1 if unconnected)"
    range -1 54
    default -1
config PC_CAMERA_PWDN
    int "PWDN GPIO (-1 if unconnected)"
    range -1 54
    default -1
endmenu
```

## sdkconfig.defaults
```kconfig
CONFIG_IDF_TARGET="esp32p4"
CONFIG_PC_BOARD_PINS_CONFIRMED=y
CONFIG_ESP32P4_SELECTS_REV_LESS_V3=y
CONFIG_ESP_DEFAULT_CPU_FREQ_MHZ_360=y
CONFIG_ESPTOOLPY_FLASHSIZE_16MB=y
CONFIG_PARTITION_TABLE_CUSTOM=y
CONFIG_PARTITION_TABLE_CUSTOM_FILENAME="partitions.csv"
CONFIG_SPIRAM=y
CONFIG_SPIRAM_MODE_HEX=y
CONFIG_IDF_EXPERIMENTAL_FEATURES=y
CONFIG_SPIRAM_SPEED_200M=y
CONFIG_CACHE_L2_CACHE_256KB=y
CONFIG_CACHE_L2_CACHE_LINE_128B=y
CONFIG_ESP_VIDEO_ENABLE_MIPI_CSI_VIDEO_DEVICE=y
CONFIG_ESP_VIDEO_ENABLE_DVP_VIDEO_DEVICE=n
CONFIG_ESP_VIDEO_ENABLE_ISP_VIDEO_DEVICE=y
CONFIG_ESP_VIDEO_ENABLE_ISP_PIPELINE_CONTROLLER=y
CONFIG_CAMERA_IMX219=y
CONFIG_CAMERA_IMX219_AUTO_DETECT_MIPI_INTERFACE_SENSOR=y
CONFIG_CAMERA_IMX219_MIPI_IF_FORMAT_INDEX_DEFAULT=0
CONFIG_CAMERA_IMX708=n
CONFIG_CAM_MOTOR_DW9807=n
CONFIG_ESP_IPA_AF_ALGORITHM=n
CONFIG_PEDESTRIAN_DETECT_MODEL_IN_FLASH_RODATA=y
CONFIG_ESP_MAIN_TASK_STACK_SIZE=24576
CONFIG_ESP_CONSOLE_UART_CUSTOM=y
CONFIG_ESP_CONSOLE_UART_BAUDRATE=921600
CONFIG_FREERTOS_HZ=1000
CONFIG_ESP_WIFI_REMOTE_ENABLED=y
CONFIG_SLAVE_IDF_TARGET_ESP32C6=y
CONFIG_ESP_HOSTED_HOST_TRANSPORT_BUS_SDIO=y
CONFIG_ESP_HOSTED_HOST_SDIO_TX_Q_SIZE=10
CONFIG_ESP_HOSTED_HOST_SDIO_RX_Q_SIZE=10
CONFIG_ESP_HOSTED_AUTO_CALL_INIT_BEFORE_APP_MAIN=n
CONFIG_HTTPD_MAX_REQ_HDR_LEN=1024
CONFIG_HTTPD_MAX_URI_LEN=256
```
